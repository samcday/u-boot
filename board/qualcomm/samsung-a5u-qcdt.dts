// SPDX-License-Identifier: GPL-2.0+

/dts-v1/;

#include <dt-bindings/arm/qcom,ids.h>

/ {
	#address-cells = <2>;
	#size-cells = <2>;

	qcom,msm-id = <QCOM_ID_MSM8916 0>;
	qcom,board-id = <0xCE08FF01 1>;

	chosen { };

	memory@80000000 {
		device_type = "memory";
		reg = <0 0x80000000 0 0>;
	};
};
