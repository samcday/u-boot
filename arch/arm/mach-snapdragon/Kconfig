## arch/arm/mach-snapdragon/Kconfig
```kconfig
if ARCH_SNAPDRAGON

config DEBUG_UART_APQ8016
	bool "APQ8016 early debug initialization"
	select CLK_QCOM_APQ8016
	select CONFIG_DEBUG_UART_MSM
	select DEBUG_UART_BOARD_INIT
	help
	  Ensures BLSP UART clocks+pins are setup. Useful when U-Boot is running from
	  aboot (such as on the dragonboard410c).

config ARCH_SNAPDRAGON_ARM32
	bool "Build Snapdragon support for ARMv7-A SoCs"
	help
	  Enable this when building U-Boot for older 32-bit Snapdragon
	  platforms, such as the MSM8960 family.

config SYS_SOC
	default "snapdragon"

config SYS_VENDOR
	string "Snapdragon board vendor"
	default "qualcomm"
	help
	  Allows to specify vendor for the Snapdragon SoCs based boards.
	  Based on this option board/<CONFIG_SYS_VENDOR>/<CONFIG_SYS_BOARD>
	  will be used as the custom board directory.

config SYS_MALLOC_LEN
	default 0x10000000

config SYS_MALLOC_F_LEN
	default 0x2000

config SPL_SYS_MALLOC_F_LEN
	default 0x2000

config SYS_MALLOC_LEN
	default 0x800000

config LNX_KRNL_IMG_TEXT_OFFSET_BASE
	default 0x80000000

config SYS_BOARD
	string "Snapdragon SoCs based board"
	help
	  Allows to specify the Snapdragon SoCs based board name.
	  Based on this option board/<CONFIG_SYS_VENDOR>/<CONFIG_SYS_BOARD>
	  will be used as the custom board directory.

config SYS_CONFIG_NAME
	string "Board configuration name"
	default SYS_BOARD if SYS_BOARD != ""
	default "qcom"
	help
	  This option contains information about board configuration name.
	  Based on this option include/configs/<CONFIG_SYS_CONFIG_NAME>.h header
	  will be used for board configuration.

endif
```

## board/efi/efi-arm_app/Kconfig
```kconfig
if TARGET_EFI_ARM_APP32

config SYS_BOARD
	default "efi-arm_app"

config SYS_VENDOR
	default "efi"

config SYS_SOC
	default "efi"

config BOARD_SPECIFIC_OPTIONS # dummy
	def_bool y
	imply VIDEO_EFI

endif
```

## board/samsung/exynos-mobile/Kconfig
```kconfig
if TARGET_EXYNOS_MOBILE

config ENV_SOURCE_FILE
	default "exynos-mobile"

config LNX_KRNL_IMG_TEXT_OFFSET_BASE
	default TEXT_BASE

config SYS_BOARD
	default "exynos-mobile"

config SYS_CONFIG_NAME
	default "exynos-mobile"

config SYS_VENDOR
	default "samsung"

config SAMSUNG_EXYNOS_LEGACY_BOOT_IMAGE
	bool "Build legacy Samsung Exynos Android boot image"
	select BINMAN
	help
	  Build a legacy Android boot image for Samsung Exynos S-BOOT devices.
	  The image layout and board-specific DTBH selector values are described by
	  the board's binman node, typically in its U-Boot-specific devicetree
	  include.

endif # TARGET_EXYNOS_MOBILE
```

## configs/efi-arm_app32_defconfig
```kconfig
CONFIG_ARM=y
CONFIG_SYS_ICACHE_OFF=y
CONFIG_SYS_DCACHE_OFF=y
CONFIG_SYS_THUMB_BUILD=y
CONFIG_NR_DRAM_BANKS=1
CONFIG_ENV_SIZE=0x1000
CONFIG_DEFAULT_DEVICE_TREE="efi-arm_app"
CONFIG_DEBUG_UART_BASE=0x0
CONFIG_DEBUG_UART_CLOCK=0
CONFIG_SYS_LOAD_ADDR=0x81000000
CONFIG_TARGET_EFI_ARM_APP32=y
CONFIG_LOGLEVEL=9
CONFIG_DEBUG_UART=y
CONFIG_EFI_CLIENT=y
CONFIG_EFI_RAM_SIZE=0x2000000
CONFIG_ENV_SOURCE_FILE="efi-arm_app"
CONFIG_FIT=y
# CONFIG_BOOTSTD is not set
CONFIG_BOOTDELAY=0
CONFIG_SYS_MALLOC_F_LEN=0x8000
CONFIG_SYS_CONSOLE_INFO_QUIET=y
# CONFIG_DISPLAY_CPUINFO is not set
CONFIG_DISPLAY_BOARDINFO_LATE=y
CONFIG_BOARD_EARLY_INIT_R=y
# CONFIG_BOARD_INIT is not set
CONFIG_SYSRESET=y
CONFIG_HUSH_PARSER=y
CONFIG_CMD_BOOTMENU=y
CONFIG_CMD_BOOTZ=y
CONFIG_CMD_DM=y
CONFIG_CMD_FDT=y
CONFIG_CMD_FAME_MDP=y
CONFIG_CMD_PART=y
CONFIG_CMD_FAT=y
CONFIG_CMD_FS_GENERIC=y
CONFIG_CMD_USB_MASS_STORAGE=y
CONFIG_CMD_FASTBOOT=y
CONFIG_EFI_PARTITION=y
CONFIG_OF_EMBED=y
CONFIG_ENV_OVERWRITE=y
CONFIG_ENV_RELOC_GD_ENV_ADDR=y
CONFIG_LOG=y
CONFIG_LOG_MAX_LEVEL=9
CONFIG_LOG_DEFAULT_LEVEL=9
CONFIG_LOGF_LINE=y
CONFIG_LOGF_FUNC=y
CONFIG_DM_WARN=y
CONFIG_DM_DEBUG=y
CONFIG_CLK=y
CONFIG_CONSOLE_FLUSH_ON_NEWLINE=y
CONFIG_NO_NET=y
CONFIG_DEBUG_EFI_CONSOLE=y
CONFIG_PANIC_HANG=y
CONFIG_POWER_DOMAIN=y
CONFIG_USB=y
CONFIG_USB_EHCI_HCD=y
CONFIG_USB_EHCI_MSM=y
CONFIG_USB_ULPI_VIEWPORT=y
CONFIG_USB_GADGET=y
CONFIG_CI_UDC=y
CONFIG_USB_GADGET_MANUFACTURER="Nokia"
CONFIG_USB_GADGET_VENDOR_NUM=0x18d1
CONFIG_USB_GADGET_PRODUCT_NUM=0x4ee0
CONFIG_USB_FUNCTION_FASTBOOT=y
CONFIG_FASTBOOT_BUF_ADDR=0x82000000
CONFIG_FASTBOOT_BUF_SIZE=0x2000000
CONFIG_USB_FUNCTION_MASS_STORAGE=y
CONFIG_VIDEO=y
CONFIG_VIDEO_EFI=y
CONFIG_SYS_WHITE_ON_BLACK=y
# CONFIG_GZIP is not set
```

## configs/nokia_fame_appsbl_defconfig
```kconfig
CONFIG_ARM=y
CONFIG_SKIP_LOWLEVEL_INIT=y
CONFIG_SYS_ICACHE_OFF=y
CONFIG_SYS_DCACHE_OFF=y
CONFIG_ARCH_SNAPDRAGON=y
CONFIG_TEXT_BASE=0x88F00000
CONFIG_NR_DRAM_BANKS=2
CONFIG_HAS_CUSTOM_SYS_INIT_SP_ADDR=y
CONFIG_CUSTOM_SYS_INIT_SP_ADDR=0x88FE0000
CONFIG_DEFAULT_DEVICE_TREE="qcom/qcom-msm8227-nokia-fame"
CONFIG_SYS_LOAD_ADDR=0x82000000
CONFIG_ARCH_SNAPDRAGON_ARM32=y
CONFIG_DEBUG_UART_BASE=0x16440000
CONFIG_DEBUG_UART_CLOCK=1843200
CONFIG_DEBUG_UART=y
CONFIG_BOOTDELAY=1
CONFIG_USE_BOOTCOMMAND=y
CONFIG_BOOTCOMMAND="fastboot usb 0"
CONFIG_CONSOLE_RECORD=y
CONFIG_CONSOLE_RECORD_OUT_SIZE=0x100000
# CONFIG_EFI_LOADER is not set
# CONFIG_DISPLAY_CPUINFO is not set
CONFIG_DISPLAY_BOARDINFO_LATE=y
CONFIG_CMD_BOOTM=y
CONFIG_CMD_BOOTZ=y
# CONFIG_CMD_ELF is not set
CONFIG_CMD_XIMG=y
# CONFIG_CMD_EXPORTENV is not set
# CONFIG_CMD_IMPORTENV is not set
# CONFIG_CMD_EDITENV is not set
# CONFIG_CMD_SAVEENV is not set
# CONFIG_CMD_ENV_EXISTS is not set
CONFIG_CMD_CRC32=y
CONFIG_CMD_ADTIMG=y
CONFIG_CMD_ABOOTIMG=y
CONFIG_CMD_LOADB=y
CONFIG_CMD_ECHO=y
# CONFIG_CMD_ITEST is not set
CONFIG_CMD_LSBLK=y
CONFIG_CMD_MMC=y
CONFIG_CMD_PART=y
CONFIG_CMD_READ=y
CONFIG_CMD_SOURCE=y
CONFIG_CMD_SETEXPR=y
CONFIG_CMD_SLEEP=y
CONFIG_EFI_PARTITION=y
CONFIG_CLK=y
CONFIG_CLK_QCOM_MSM8960=y
CONFIG_DEBUG_UART_MSM_GSBI_BASE=0x16400000
CONFIG_DEBUG_UART_MSM_GSBI_MODE=6
CONFIG_DEBUG_UART_ANNOUNCE=y
CONFIG_MSM_SERIAL=y
CONFIG_FASTBOOT_FLASH=y
CONFIG_FASTBOOT_FLASH_BLOCK=y
CONFIG_FASTBOOT_FLASH_BLOCK_INTERFACE_NAME="mmc"
CONFIG_FASTBOOT_FLASH_BLOCK_DEVICE_ID=0
CONFIG_FASTBOOT_FETCH=y
CONFIG_ARM_PL180_MMCI=y
# CONFIG_MMC_HW_PARTITIONING is not set
CONFIG_USB=y
# CONFIG_DM_USB_GADGET is not set
CONFIG_USB_EHCI_HCD=y
CONFIG_USB_EHCI_MSM=y
CONFIG_USB_ULPI_VIEWPORT=y
CONFIG_USB_GADGET=y
CONFIG_CI_UDC=y
CONFIG_USB_FUNCTION_FASTBOOT=y
CONFIG_USB_GADGET_MANUFACTURER="Nokia"
CONFIG_USB_GADGET_VENDOR_NUM=0x18D1
CONFIG_USB_GADGET_PRODUCT_NUM=0x4EE0
CONFIG_FASTBOOT_OEM_RUN=y
CONFIG_FASTBOOT_CMD_OEM_CONSOLE=y
CONFIG_FASTBOOT_CMD_LOGICAL_PARTITIONS=y
CONFIG_FASTBOOT_BUF_ADDR=0x82000000
CONFIG_FASTBOOT_BUF_SIZE=0x04000000
```

## configs/nokia_fame_defconfig
```kconfig
CONFIG_ARM=y
CONFIG_SKIP_LOWLEVEL_INIT=y
CONFIG_SYS_DCACHE_OFF=y
CONFIG_ARCH_SNAPDRAGON=y
CONFIG_TEXT_BASE=0x88F00000
CONFIG_NR_DRAM_BANKS=2
CONFIG_HAS_CUSTOM_SYS_INIT_SP_ADDR=y
CONFIG_CUSTOM_SYS_INIT_SP_ADDR=0x88FE0000
CONFIG_DEFAULT_DEVICE_TREE="qcom/qcom-msm8227-nokia-fame"
CONFIG_SYS_LOAD_ADDR=0x82000000
CONFIG_ARCH_SNAPDRAGON_ARM32=y
CONFIG_DEBUG_UART_BASE=0x16440000
CONFIG_DEBUG_UART_CLOCK=1843200
CONFIG_DEBUG_UART=y
CONFIG_BOOTDELAY=-1
# CONFIG_EFI_LOADER is not set
# CONFIG_DISPLAY_CPUINFO is not set
CONFIG_DISPLAY_BOARDINFO_LATE=y
# CONFIG_CMD_BOOTM is not set
# CONFIG_CMD_ELF is not set
# CONFIG_CMD_XIMG is not set
# CONFIG_CMD_EXPORTENV is not set
# CONFIG_CMD_IMPORTENV is not set
# CONFIG_CMD_EDITENV is not set
# CONFIG_CMD_SAVEENV is not set
# CONFIG_CMD_ENV_EXISTS is not set
# CONFIG_CMD_CRC32 is not set
# CONFIG_CMD_LOADB is not set
# CONFIG_CMD_LOADS is not set
# CONFIG_CMD_ECHO is not set
# CONFIG_CMD_ITEST is not set
# CONFIG_CMD_SOURCE is not set
# CONFIG_CMD_SETEXPR is not set
# CONFIG_CMD_SLEEP is not set
CONFIG_DEBUG_UART_MSM_GSBI_BASE=0x16400000
CONFIG_DEBUG_UART_MSM_GSBI_MODE=6
CONFIG_DEBUG_UART_ANNOUNCE=y
CONFIG_MSM_SERIAL=y
CONFIG_SYSRESET_QCOM_PSHOLD=y
```

## configs/nokia_fame_lk_fastboot_defconfig
```kconfig
CONFIG_ARM=y
CONFIG_SKIP_LOWLEVEL_INIT=y
CONFIG_SYS_ICACHE_OFF=y
CONFIG_SYS_DCACHE_OFF=y
CONFIG_ARCH_SNAPDRAGON=y
CONFIG_TEXT_BASE=0x80208000
CONFIG_NR_DRAM_BANKS=2
CONFIG_HAS_CUSTOM_SYS_INIT_SP_ADDR=y
CONFIG_CUSTOM_SYS_INIT_SP_ADDR=0x88FE0000
CONFIG_DEFAULT_DEVICE_TREE="qcom/qcom-msm8227-nokia-fame"
CONFIG_SYS_LOAD_ADDR=0x82000000
CONFIG_ARCH_SNAPDRAGON_ARM32=y
CONFIG_DEBUG_UART_BASE=0x16440000
CONFIG_DEBUG_UART_CLOCK=7372800
CONFIG_DEBUG_UART=y
CONFIG_BOOTDELAY=1
CONFIG_USE_BOOTCOMMAND=y
CONFIG_BOOTCOMMAND="fastboot usb 0"
CONFIG_CONSOLE_RECORD=y
CONFIG_CONSOLE_RECORD_OUT_SIZE=0x20000
# CONFIG_EFI_LOADER is not set
# CONFIG_DISPLAY_CPUINFO is not set
CONFIG_DISPLAY_BOARDINFO_LATE=y
# CONFIG_CMD_BOOTM is not set
# CONFIG_CMD_ELF is not set
# CONFIG_CMD_XIMG is not set
# CONFIG_CMD_EXPORTENV is not set
# CONFIG_CMD_IMPORTENV is not set
# CONFIG_CMD_EDITENV is not set
# CONFIG_CMD_SAVEENV is not set
# CONFIG_CMD_ENV_EXISTS is not set
# CONFIG_CMD_CRC32 is not set
CONFIG_CMD_LOADB=y
# CONFIG_CMD_ECHO is not set
# CONFIG_CMD_ITEST is not set
# CONFIG_CMD_SOURCE is not set
# CONFIG_CMD_SETEXPR is not set
CONFIG_CMD_SLEEP=y
CONFIG_DEBUG_UART_MSM_GSBI_BASE=0x16400000
CONFIG_DEBUG_UART_MSM_GSBI_MODE=6
CONFIG_DEBUG_UART_ANNOUNCE=y
CONFIG_MSM_SERIAL=y
CONFIG_USB=y
# CONFIG_DM_USB_GADGET is not set
CONFIG_USB_EHCI_HCD=y
CONFIG_USB_EHCI_MSM=y
CONFIG_USB_ULPI_VIEWPORT=y
CONFIG_USB_GADGET=y
CONFIG_CI_UDC=y
CONFIG_USB_FUNCTION_FASTBOOT=y
CONFIG_USB_GADGET_MANUFACTURER="Nokia"
CONFIG_USB_GADGET_VENDOR_NUM=0x18D1
CONFIG_USB_GADGET_PRODUCT_NUM=0x4EE0
CONFIG_FASTBOOT_OEM_RUN=y
CONFIG_FASTBOOT_CMD_OEM_CONSOLE=y
CONFIG_FASTBOOT_BUF_ADDR=0x82000000
CONFIG_FASTBOOT_BUF_SIZE=0x04000000
```

## configs/qcom_armv7_defconfig
```kconfig
CONFIG_ARM=y
CONFIG_SKIP_LOWLEVEL_INIT=y
CONFIG_SYS_ICACHE_OFF=y
CONFIG_SYS_DCACHE_OFF=y
CONFIG_ARCH_SNAPDRAGON=y
CONFIG_TEXT_BASE=0x80208000
CONFIG_NR_DRAM_BANKS=24
CONFIG_HAS_CUSTOM_SYS_INIT_SP_ADDR=y
CONFIG_CUSTOM_SYS_INIT_SP_ADDR=0x88FE0000
CONFIG_DEFAULT_DEVICE_TREE="qcom/qcom-msm8960-cdp"
CONFIG_SYS_LOAD_ADDR=0x82000000
CONFIG_ARCH_SNAPDRAGON_ARM32=y
CONFIG_EFI_RUNTIME_UPDATE_CAPSULE=y
CONFIG_EFI_CAPSULE_ON_DISK=y
CONFIG_EFI_CAPSULE_FIRMWARE_RAW=y
# CONFIG_ANDROID_BOOT_IMAGE is not set
CONFIG_BOOTSTD_FULL=y
CONFIG_BOOTDELAY=1
CONFIG_SYS_CBSIZE=512
# CONFIG_DISPLAY_CPUINFO is not set
CONFIG_DISPLAY_BOARDINFO_LATE=y
CONFIG_CMD_BOOTMENU=y
CONFIG_CMD_MEMINFO=y
CONFIG_CMD_MEMINFO_MAP=y
# CONFIG_CMD_BIND is not set
CONFIG_CMD_CLK=y
CONFIG_CMD_GPIO=y
CONFIG_CMD_MMC=y
CONFIG_CMD_USB_MASS_STORAGE=y
CONFIG_CMD_CAT=y
CONFIG_CMD_BMP=y
CONFIG_CMD_LOG=y
CONFIG_OF_UPSTREAM_BUILD_VENDOR=y
CONFIG_ENV_USE_DEFAULT_ENV_TEXT_FILE=y
CONFIG_ENV_DEFAULT_ENV_TEXT_FILE="board/qualcomm/default.env"
CONFIG_CLK=y
CONFIG_CLK_QCOM_MSM8960=y
CONFIG_USB_FUNCTION_FASTBOOT=y
CONFIG_FASTBOOT_BUF_ADDR=0x0
CONFIG_FASTBOOT_FLASH=y
CONFIG_FASTBOOT_FLASH_MMC_DEV=0
CONFIG_FASTBOOT_MMC_USER_SUPPORT=y
CONFIG_MSM_GPIO=y
CONFIG_DM_KEYBOARD=y
CONFIG_BUTTON_KEYBOARD=y
CONFIG_PINCTRL=y
CONFIG_PINCTRL_QCOM_MSM8960=y
CONFIG_MSM_SERIAL=y
CONFIG_SYSRESET_QCOM_PSHOLD=y
CONFIG_TIMER=y
CONFIG_QCOM_KPSS_TIMER=y
CONFIG_USB=y
# CONFIG_DM_USB_GADGET is not set
CONFIG_USB_EHCI_HCD=y
CONFIG_USB_EHCI_MSM=y
CONFIG_USB_GADGET=y
CONFIG_CI_UDC=y
CONFIG_VIDEO=y
CONFIG_SYS_WHITE_ON_BLACK=y
CONFIG_NO_FB_CLEAR=y
CONFIG_VIDEO_SIMPLE=y
```

## configs/qcom_msm8916_defconfig
```kconfig
#include "qcom_defconfig"

# Chipidea UDC conflicts with DWC3
# CONFIG_USB_XHCI_DWC3 is not set
# CONFIG_USB_DWC3 is not set
# CONFIG_USB_DWC3_GENERIC is not set

CONFIG_CI_UDC=y
CONFIG_CMD_USB_MASS_STORAGE=y
CONFIG_DM_USB=y
CONFIG_LINUX_KERNEL_IMAGE_HEADER=y
CONFIG_MSM8916_USB_PHY=y
CONFIG_USB_EHCI_HCD=y
CONFIG_USB_EHCI_MSM=y
CONFIG_USB_FUNCTION_ACM=y
CONFIG_USB_GADGET_PRODUCT_NUM=0xd00d
CONFIG_USB_GADGET_VENDOR_NUM=0x18d1
CONFIG_USB_ULPI=y
CONFIG_USB_ULPI_VIEWPORT=y
```

## configs/samsung_j7xelte_defconfig
```kconfig
CONFIG_ARM=y
CONFIG_SKIP_LOWLEVEL_INIT=y
CONFIG_COUNTER_FREQUENCY=26000000
CONFIG_ARCH_EXYNOS=y
CONFIG_TEXT_BASE=0x40001000
CONFIG_SYS_MALLOC_F_LEN=0x400
CONFIG_ARCH_EXYNOS7=y
CONFIG_TARGET_A5Y17LTE=y
CONFIG_NR_DRAM_BANKS=12
CONFIG_HAS_CUSTOM_SYS_INIT_SP_ADDR=y
CONFIG_CUSTOM_SYS_INIT_SP_ADDR=0x40200e50
CONFIG_DEFAULT_DEVICE_TREE="exynos78x0-j7xelte"
CONFIG_SYS_BOOTM_LEN=0x2000000
CONFIG_SYS_LOAD_ADDR=0x40001000
CONFIG_FIT=y
CONFIG_USE_PREBOOT=y
CONFIG_PREBOOT="echo hi mom"
CONFIG_SAVE_PREV_BL_FDT_ADDR=y
CONFIG_SAVE_PREV_BL_INITRAMFS_START_ADDR=y
CONFIG_SYS_PBSIZE=1024
# CONFIG_DISPLAY_CPUINFO is not set
CONFIG_HUSH_PARSER=y
CONFIG_CMD_GPIO=y
CONFIG_CMD_I2C=y
CONFIG_DM_I2C_GPIO=y
```
