// SPDX-License-Identifier: GPL-2.0+

/dts-v1/;

/ {
	#address-cells = <1>;
	#size-cells = <1>;

	binman {
		qcdt {
			type = "qcom-qcdt";
			page-size = <0x800>;
			qcom,msm-id = <0xce 0>;
			qcom,board-id = <0xce08ff01 1>;
		};
	};
};
